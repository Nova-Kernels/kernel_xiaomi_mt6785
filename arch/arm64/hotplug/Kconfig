## arch/arm64/hotplug/Kconfig
```kconfig
config HIMA_HOTPLUG
        bool "Enable hima-hotplug cpu hotplug driver"
	depends on STATE_NOTIFIER
        default n
        help
          Generic cpu hotplugging driver for ARM SOCs
```

## drivers/misc/mediatek/usb_boost/Kconfig
```kconfig
config MTK_USB_BOOST
    bool "MediaTek USB boost driver"
    depends on USB && MTK_CPU_CTRL
    help
      Say Y here if you want to enable USB boost driver.
      This driver is used to boost CPU frequency and DRAM voltage
      when USB is plugged in.
```

## drivers/misc/mediatek/vibrator/Kconfig
```kconfig
config MTK_VIBRATOR
	tristate "MediaTek Vibrator driver"
	default n
	  ---help---
	  Vibrator driver support for MediaTek SOC.
	  You can customize the vibrate strength and lowest vibrate time.
	  If you want to use MediaTek Vibrator driver, say Y or M here.
	  If unsure, say N.

config THUNDERQUAKE_ENGINE_GPL
	tristate "Vibrator Intensity Controller for MTK Vibrator"
	default y
	  ---help---
	  Vibrator Intensity Controller for MTK Vibrator v1.1
```
